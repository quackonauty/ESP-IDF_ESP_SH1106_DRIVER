## Kconfig.projbuild
```kconfig
menu "ESP SH1106 Driver"

    # -------------------------------------------------------------------------
    # I2C Parameters
    # -------------------------------------------------------------------------

    config ESP_SH1106_DRIVER_I2C_ADDR
        hex "I2C device address (7-bit)"
        default 0x3C
        range 0x3C 0x3D
        help
            7-bit I2C address of the SH1106.
            Module silkscreen / datasheet usually quotes the 8-bit address:
              0x78 (write) -> 7-bit 0x3C  (SA0 low, default)
              0x7A (write) -> 7-bit 0x3D  (SA0 high, resistor/jumper moved)
            ESP-IDF expects the 7-bit value, i.e. 0x3C or 0x3D.

    config ESP_SH1106_DRIVER_I2C_SCL_SPEED_HZ
        int "I2C SCL clock speed (Hz)"
        default 400000
        range 100000 400000
        help
            I2C bus clock frequency. 400 000 Hz (Fast Mode) is recommended.
            Use 100 000 Hz (Standard Mode) only if your wiring requires it.

    config ESP_SH1106_DRIVER_I2C_TIMEOUT_MS
        int "I2C transaction timeout (ms)"
        default 1000
        range 10 1000
        help
            Timeout for I2C bus transactions and mutex wait.
            Increase only if experiencing spurious timeouts on a loaded bus.

    # -------------------------------------------------------------------------
    # Display Geometry
    # -------------------------------------------------------------------------

    config ESP_SH1106_DRIVER_COLUMN_OFFSET
        int "Column offset (RAM columns)"
        default 2
        range 0 4
        help
            The SH1106 has 132 columns of display RAM but the 1.3-inch panel
            (128x64) is centred on them, so the usual offset is 2.
            If the image looks shifted by 2 pixels or you see garbage pixels
            on one edge, try 0 or 4. The panel is fixed at 128x64.

    # -------------------------------------------------------------------------
    # Display Orientation
    # -------------------------------------------------------------------------

    config ESP_SH1106_DRIVER_FLIP
        bool "Flip display 180 degrees"
        default n
        help
            Reverses the COM scan direction and segment remap so the display
            renders upside-down. Useful when the module is mounted inverted
            inside an enclosure.

    # -------------------------------------------------------------------------
    # Rendering Features
    # -------------------------------------------------------------------------

    config ESP_SH1106_DRIVER_ENABLE_FLOAT
        bool "Enable float rendering  (buffer_float)"
        default n
        help
            Renders a float with configurable decimal places using snprintf.
            WARNING: may pull in C library float-formatting code (~3-5 KB flash).
            Only enable if needed.

    # -------------------------------------------------------------------------
    # Log Level
    # -------------------------------------------------------------------------

    choice ESP_SH1106_DRIVER_LOG_LEVEL_CHOICE
        prompt "Log level"
        default ESP_SH1106_DRIVER_LOG_LEVEL_INFO
        help
            Component log verbosity. Controls the ESP_LOGx macros inside
            the component, independently of the global log level.
            Set to Error in production builds to suppress Info messages.

        config ESP_SH1106_DRIVER_LOG_LEVEL_NONE
            bool "None"
        config ESP_SH1106_DRIVER_LOG_LEVEL_ERROR
            bool "Error"
        config ESP_SH1106_DRIVER_LOG_LEVEL_WARN
            bool "Warn"
        config ESP_SH1106_DRIVER_LOG_LEVEL_INFO
            bool "Info"
        config ESP_SH1106_DRIVER_LOG_LEVEL_DEBUG
            bool "Debug"
        config ESP_SH1106_DRIVER_LOG_LEVEL_VERBOSE
            bool "Verbose"

    endchoice

    config ESP_SH1106_DRIVER_LOG_LEVEL
        int
        default 0 if ESP_SH1106_DRIVER_LOG_LEVEL_NONE
        default 1 if ESP_SH1106_DRIVER_LOG_LEVEL_ERROR
        default 2 if ESP_SH1106_DRIVER_LOG_LEVEL_WARN
        default 3 if ESP_SH1106_DRIVER_LOG_LEVEL_INFO
        default 4 if ESP_SH1106_DRIVER_LOG_LEVEL_DEBUG
        default 5 if ESP_SH1106_DRIVER_LOG_LEVEL_VERBOSE

endmenu
```
